## example/IDF/examples/lvgl9_demo/components/bsp/Kconfig.projbuild
```kconfig
menu "Board Configuration"

    config BSP_SPIFFS
        bool "Enable SPIFFS filesystem support"
        default n
        help
            Enable SPIFFS filesystem support
            
endmenu
```

## example/IDF/examples/lvgl9_demo/main/Kconfig.projbuild
```kconfig
menu "Makerfabs Project"


choice BOARD_TYPE
    prompt "Board Type"
    default BOARD_TYPE_MATOUCH_1_8_S3
    help
        Board type. 开发板类型
    config BOARD_TYPE_MATOUCH_AI_28_S3
        bool "matouch-ai-28-s3"
        depends on IDF_TARGET_ESP32S3
    config BOARD_TYPE_MATOUCH_1_8_S3
        bool "matouch-1-8-s3"
        depends on IDF_TARGET_ESP32S3
    config BOARD_TYPE_MATOUCH_3_16_S3
        bool "matouch-3-16-s3"
        depends on IDF_TARGET_ESP32S3
endchoice


endmenu
```
